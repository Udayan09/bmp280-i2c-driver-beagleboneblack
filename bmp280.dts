/dts-v1/;
/plugin/;

/{
	fragment@0 {
		target = <&i2c2>;
		__overlay__ {

			#address-cells = <1>;
            #size-cells = <0>;

			
			pressure: bmp280@76 {
				reg = <0x76>;
				compatible = "bosch,bmp280";
			};
		};
	};
};